## meta-rz-features/conf/layer.conf
```bitbake
# We have a conf and classes directory, add to BBPATH

include ${LAYERDIR}/include/graphic/feature.inc
include ${LAYERDIR}/include/codec/plugin.inc
BBPATH .= ":${LAYERDIR}"

BBFILE_COLLECTIONS += "rz-features"
BBFILE_PATTERN_rz-features := "^${LAYERDIR}/"
LAYERSERIES_COMPAT_rz-features  = "dunfell"
LAYERDEPENDS_rz-features = "rzg2"

# We have recipes-* directories, add to BBFILES
BBFILES += "${LAYERDIR}/recipes-*/*/*.bb \
    ${LAYERDIR}/recipes-*/*.bb \
    ${LAYERDIR}/recipes-*/*.bbappend \
    ${LAYERDIR}/recipes-*/*/*.bbappend"

# Add DRP-AI Support PKG
DRPAI_RECIPES = "${@os.path.isdir("${LAYERDIR}/recipes-drpai")}"

BBFILES_append += "${@'${LAYERDIR}/recipes-drpai/*/*/*.bb' if '${DRPAI_RECIPES}' == 'True' else ''} \
                   ${@'${LAYERDIR}/recipes-drpai/*/*/*/*.bb' if '${DRPAI_RECIPES}' == 'True' else ''} \
                   ${@'${LAYERDIR}/recipes-drpai/*/*/*.bbappend' if '${DRPAI_RECIPES}' == 'True' else ''} \
                   ${@'${LAYERDIR}/recipes-drpai/*/*/*/*.bbappend' if '${DRPAI_RECIPES}' == 'True' else ''} "


# Add OpenCVA PKG
OPENCVA_RECIPES = "${@os.path.isdir("${LAYERDIR}/recipes-opencva")}"

BBFILES_append += "${@'${LAYERDIR}/recipes-opencva/*/*/*.bb' if '${OPENCVA_RECIPES}' == 'True' else ''} \
                   ${@'${LAYERDIR}/recipes-opencva/*/*/*/*.bb' if '${OPENCVA_RECIPES}' == 'True' else ''} \
                   ${@'${LAYERDIR}/recipes-opencva/*/*/*.bbappend' if '${OPENCVA_RECIPES}' == 'True' else ''} \
                   ${@'${LAYERDIR}/recipes-opencva/*/*/*/*.bbappend' if '${OPENCVA_RECIPES}' == 'True' else ''} "
```

## meta-rz-features/meta-rzv2ma-codec/conf/layer.conf
```bitbake
# We have a conf and classes directory, add to BBPATH
include ${LAYERDIR}/include/graphic/feature.inc
include ${LAYERDIR}/include/codec/plugin.inc

BBPATH .= ":${LAYERDIR}"

# We have recipes-* directories, add to BBFILES
BBFILES += "${LAYERDIR}/recipes-*/*/*.bb \
            ${LAYERDIR}/recipes-*/*/*.bbappend \
            ${LAYERDIR}/recipes-*/*/*/*.bb \
            ${LAYERDIR}/recipes-*/*/*/*.bbappend"

BBFILE_COLLECTIONS += "rzv2ma-codec"
BBFILE_PATTERN_rzv2ma-codec := "^${LAYERDIR}/"

LAYERDEPENDS_rzv2ma-codec = "rzv2m"
LAYERSERIES_COMPAT_rzv2ma-codec = "dunfell"
```
